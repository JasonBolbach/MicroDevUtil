#pragma once
// Is a name safe to use as a C++ member / class name in the generated code, in a sketch for Arduino, ESP32, Pico and the desktop?
// FD::ValidName(s) (FormModel.h) = a plain identifier AND !FD::IsReserved(s). A name is reserved when it is
//   1. a C++ keyword (the whole C++23 list: alternative tokens, char8_t, co_await, static_assert, ... and the contextual final / override / import / module),
//   2. a name the generated class itself defines (Form, Show, Service, Dst, FormWidth, ...),
//   3. a reserved-identifier shape: a leading underscore, or a double underscore anywhere,
//   4. a name that would collide inside the generated class: handler names (<control>_Click / _Change / _Accept and their _Thunk), SuperGUI and
//      LovyanGFX types (Super*, lgfx, LGFX*), the stdint / size types,
//   5. a name the Arduino / ESP32 / Pico / C library world defines as a macro or global: HIGH, LOW, INPUT, PI, min, max, delay, Serial, NULL, EOF, ...
//      (curated here), pin names (A0, D13, GPIO5), the TFT_ / ESP / PICO prefixes, and
//   6. any macro the generated code's own headers define (ReservedMacros.h, generated by scripts/gen_reserved_macros.sh from the real headers).
#include <algorithm>
#include <cctype>
#include <cstring>
#include <string>
#include "ReservedMacros.h"

namespace FD {
namespace detail {
template <size_t N> inline bool In(const char* const (&t)[N], const std::string& s) { for (const char* w : t) if (s == w) return true; return false; }
inline bool StartsWith(const std::string& s, const char* p) { return s.compare(0, strlen(p), p) == 0; }
inline bool EndsWith(const std::string& s, const char* x) { size_t n = strlen(x); return s.size() >= n && s.compare(s.size() - n, n, x) == 0; }
}

inline bool IsKeyword(const std::string& s) {
    static const char* const k[] = {
        "alignas", "alignof", "and", "and_eq", "asm", "atomic_cancel", "atomic_commit", "atomic_noexcept", "auto", "bitand", "bitor", "bool", "break",
        "case", "catch", "char", "char8_t", "char16_t", "char32_t", "class", "compl", "concept", "const", "consteval", "constexpr", "constinit",
        "const_cast", "continue", "contract_assert", "co_await", "co_return", "co_yield", "decltype", "default", "delete", "do", "double",
        "dynamic_cast", "else", "enum", "explicit", "export", "extern", "false", "float", "for", "friend", "goto", "if", "inline", "int", "long",
        "mutable", "namespace", "new", "noexcept", "not", "not_eq", "nullptr", "operator", "or", "or_eq", "private", "protected", "public",
        "reflexpr", "register", "reinterpret_cast", "requires", "return", "short", "signed", "sizeof", "static", "static_assert", "static_cast",
        "struct", "switch", "synchronized", "template", "this", "thread_local", "throw", "true", "try", "typedef", "typeid", "typename", "union",
        "unsigned", "using", "virtual", "void", "volatile", "wchar_t", "while", "xor", "xor_eq",
        "final", "override", "import", "module", "restrict", "typeof", "main", "setup", "loop" };
    return detail::In(k, s);
}

inline bool IsGeneratorName(const std::string& s) {                     // what the generated class defines itself
    static const char* const g[] = { "Form", "Show", "Service", "Dst", "FormWidth", "FormHeight", "FormBackColor", "InitializeComponent" };
    return detail::In(g, s);
}

inline bool IsMacroName(const std::string& s) { return std::binary_search(std::begin(kReservedMacros), std::end(kReservedMacros), s.c_str(), [](const char* a, const char* b) { return strcmp(a, b) < 0; }); }

inline bool IsPlatformName(const std::string& s) {                      // Arduino / ESP32 / Pico / C library names the headers above do not all show
    static const char* const p[] = {
        "HIGH", "LOW", "INPUT", "OUTPUT", "INPUT_PULLUP", "INPUT_PULLDOWN", "OUTPUT_OPEN_DRAIN", "LED_BUILTIN", "PI", "HALF_PI", "TWO_PI", "DEG_TO_RAD",
        "RAD_TO_DEG", "EULER", "SERIAL", "DISPLAY", "LSBFIRST", "MSBFIRST", "CHANGE", "FALLING", "RISING", "ONLOW", "ONHIGH", "DEFAULT", "EXTERNAL",
        "INTERNAL", "DEC", "HEX", "OCT", "BIN", "min", "max", "abs", "constrain", "round", "radians", "degrees", "sq", "bit", "bitRead", "bitSet",
        "bitClear", "bitWrite", "lowByte", "highByte", "word", "byte", "boolean", "String", "Serial", "Serial0", "Serial1", "Serial2", "Wire", "Wire1",
        "SPI", "Stream", "Print", "Printable", "IPAddress", "Client", "Server", "Udp", "WiFi", "delay", "delayMicroseconds", "millis", "micros",
        "pinMode", "digitalWrite", "digitalRead", "analogRead", "analogWrite", "tone", "noTone", "pulseIn", "shiftIn", "shiftOut", "attachInterrupt",
        "detachInterrupt", "interrupts", "noInterrupts", "random", "randomSeed", "map", "sin", "cos", "tan", "sqrt", "pow", "log", "exp", "floor", "ceil",
        "fabs", "isnan", "isinf", "F", "PSTR", "PROGMEM", "SDA", "SCL", "SS", "MOSI", "MISO", "SCK", "TX", "RX", "linux", "unix", "i386",
        "NULL", "EOF", "errno", "assert", "stdin", "stdout", "stderr", "offsetof", "va_list", "std", "FILE", "size_t", "ssize_t", "ptrdiff_t", "wint_t",
        "int8_t", "int16_t", "int32_t", "int64_t", "uint8_t", "uint16_t", "uint32_t", "uint64_t", "intptr_t", "uintptr_t", "intmax_t", "uintmax_t",
        "nullptr_t", "max_align_t", "time", "clock", "exit", "abort", "printf", "sprintf", "snprintf", "malloc", "free", "memcpy", "memset", "strlen" };
    return detail::In(p, s);
}

inline bool IsReserved(const std::string& s) {
    using namespace detail;
    if (IsKeyword(s) || IsGeneratorName(s) || IsPlatformName(s) || IsMacroName(s)) return true;
    if (s.empty()) return false;
    if (s[0] == '_' || s.find("__") != std::string::npos) return true;                                         // reserved identifier shapes
    if (EndsWith(s, "_Click") || EndsWith(s, "_Change") || EndsWith(s, "_Accept") || EndsWith(s, "_ClickThunk") || EndsWith(s, "_ChangeThunk") || EndsWith(s, "_AcceptThunk")) return true;   // handler names of the generated class
    if (StartsWith(s, "Super") || s == "lgfx" || StartsWith(s, "LGFX") || StartsWith(s, "lgfx")) return true;   // SuperGUI / LovyanGFX types and namespaces
    if (StartsWith(s, "TFT_") || StartsWith(s, "ESP") || StartsWith(s, "esp_") || StartsWith(s, "GPIO") || StartsWith(s, "gpio_") || StartsWith(s, "PICO") ||
        StartsWith(s, "pico_") || StartsWith(s, "ARDUINO")) return true;                                       // board / SDK families
    if ((s[0] == 'A' || s[0] == 'D' || s[0] == 'P') && s.size() > 1 && std::all_of(s.begin() + 1, s.end(), [](unsigned char c) { return isdigit(c); })) return true;   // pins: A0 D13 P4
    return false;
}
}
